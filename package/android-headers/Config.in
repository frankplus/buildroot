## package/android-headers/Config.in
```kconfig
config BR2_PACKAGE_ANDROID_HEADERS
    bool "android-headers"
    help
      Android headers are necessary for building libraries like
      libhybris that depend on the Android HAL layer.

      Select this package if you need to build projects that
      rely on Android headers.

      https://github.com/Halium/android-headers
```

## package/hello-world/Config.in
```kconfig
config BR2_PACKAGE_HELLO_WORLD
    bool "hello-world"
    help
      This is a simple Hello World program using autotools.
      Source: https://github.com/irvanherz/hello-world-autotools-template
```

## package/libhybris/Config.in
```kconfig
config BR2_PACKAGE_LIBHYBRIS
    bool "libhybris"
    help
      libhybris is a library for using Android drivers in Linux.
```

## toolchain/toolchain-clang-external/Config.in
```kconfig
if BR2_TOOLCHAIN_CLANG_EXTERNAL

config BR2_TOOLCHAIN_EXTERNAL_SYSROOT_DIR
    string "External toolchain sysroot directory"
    depends on BR2_TOOLCHAIN_CLANG_EXTERNAL
    help
      Specify the sysroot directory for the external Clang toolchain.
      This is needed to correctly locate the headers and libraries
      for the target system.

config BR2_TOOLCHAIN_EXTERNAL_MUSL_SYSROOT_DIR
    string "External toolchain musl sysroot directory"
    depends on BR2_TOOLCHAIN_CLANG_EXTERNAL
    help
      Specify the sysroot directory for the external musl toolchain.
      This is needed to correctly locate the headers and libraries
      for the target system.


endif # BR2_TOOLCHAIN_CLANG_EXTERNAL
```
